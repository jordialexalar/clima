-!                 -LNK8051.XCL-
        XLINK 4.2x command file to be used with the 8051 C-compiler V4.xx
        using the -mt, -ms, -mc, -mm or -ml memory model
        Usage:  xlink  your_file(s)  -f lnk8051l -!





dleucom2


-!        First: define CPU  -!





-c8051
-Faomf8051

-!  Select register bank [0,8,10 or 18] -!

-D_R=0


-!  Setup "bit" segments (always zero if there is no need to reserve
    bit variable space for some other purpose) -!

-Z(BIT)C_ARGB,BITVARS=0


-!  Setup "data" segments.  Start address may not be less
    than _R+8 (start of register bank + 8).  Space must also
    be left for interrupt functions with the "using" attribute.
    That is, if _R is 0 and there is an interrupt function with
    using [1], the start address should be set to 10 (hex) -!

-Z(DATA)C_ARGD,D_UDATA,D_IDATA=8

-!  Setup "idata" segments (usually loaded after "data") -!

-Z(IDATA)C_ARGI,I_UDATA,I_IDATA,CSTACK


-!  Setup "xdata" segments to the start address of external RAM.
    Note that this declaration does no harm even if you use a memory
    model that does not utilize external data RAM -!

-Z(XDATA)C_ARGX+400=500
-Z(XDATA)X_UDATA,X_IDATA,ECSTR,RF_XDATA=1000

-!  Setup all read-only segments (PROM). Usually at zero -!

-Z(CODE)INTVEC,RCODE,D_CDATA,I_CDATA,X_CDATA,C_ICALL,C_RECFN,CSTR,CCSTR,CODE,CONST=0


-!  See configuration section concerning printf/sprintf -!
-! -e_small_write=_formatted_write -!


-!  See configuration section concerning scanf/sscanf -!
-! -e_medium_read=_formatted_read -!


-!  Load the 'C' library adapted for the selected memory model -!
c:\icc1\cl8051l  -! or cl8051s, cl8051c, cl8051m, cl8051l -!


-!  Code will now reside on file aout.a03 in INTEL-STANDARD format -!
-o dleucom2.eje
-a
-m